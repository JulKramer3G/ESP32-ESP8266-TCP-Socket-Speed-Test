#include <Arduino.h>
#include <WiFi.h>
#include <list>
#include "wifi_credentials.hpp"

const char *ssid = WIFI_SSID; // replace this with your network ssid
const char *password = WIFI_PASSWORD; // replace this with your network password

#define ARRAY_SIZE 2048

uint8_t testArray[ARRAY_SIZE] = {
    0x0,  0x1,  0x2,  0x3,  0x4,  0x5,  0x6,  0x7,  0x8,  0x9,  0xa,  0xb,
    0xc,  0xd,  0xe,  0xf,  0x10, 0x11, 0x12, 0x13, 0x14, 0x15, 0x16, 0x17,
    0x18, 0x19, 0x1a, 0x1b, 0x1c, 0x1d, 0x1e, 0x1f, 0x20, 0x21, 0x22, 0x23,
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    0xf8, 0xf9, 0xfa, 0xfb, 0xfc, 0xfd, 0xfe, 0xff};

#define BASE_PORT 80
#define MANAGEMENT_PORT 1000

void parallelTest() {
  while (true) {
    Serial.println("Welcome to this test, please use the python script now.");
    // get number of concurrent channels from client
    bool userHasSetNumberOfChannels = false;
    int connectionCount = 0;
    while (userHasSetNumberOfChannels == false) {
      WiFiServer *managementServer = new WiFiServer(MANAGEMENT_PORT);
      managementServer->begin();

      while (userHasSetNumberOfChannels == false) {
        WiFiClient client = managementServer->available();

        if (client) {
          Serial.printf("Management client connected, system time: %d\n",
                        millis());
          delay(100);
          while (client.connected()) {
            connectionCount = client.read();
            if (connectionCount > 0) {
              Serial.printf("Client has set channel count: %d\n",
                            connectionCount);
              userHasSetNumberOfChannels = true;
              break;
            } else {
              // Serial.printf("Waiting for channel count, received: %d\n",
              //               connectionCount);
              delay(500);
            }
          }

          client.stop();
          Serial.println("Client disconnected");
        }
      }
      managementServer->close();
      managementServer->end();
      delete (managementServer);
      Serial.println("Stopped server");
    }

    Serial.println("Creating connections");
    std::list<WiFiServer *> servers;

    for (uint8_t i = 0; i < connectionCount; i += 1) {
      WiFiServer *newServer = new WiFiServer(BASE_PORT + i);
      newServer->begin();
      servers.push_back(newServer);
    }

    std::list<WiFiServer *> alreadySeenConnected;
    std::list<WiFiClient> myClients;

    Serial.println("Waiting for clients");

    bool testActive = true;

    while (testActive) {
      bool allClientsConnected = true;
      uint8_t count = 0;
      for (WiFiServer *serv : servers) {
        if (std::find(alreadySeenConnected.begin(), alreadySeenConnected.end(),
                      serv) != alreadySeenConnected.end()) {
          count += 1;
          continue;
        }
        WiFiClient client = serv->available();
        if (client) {
          if (client.connected() == true) {
            Serial.printf("Client no. %d connected\n", count);
            myClients.push_back(client);
            alreadySeenConnected.push_back(serv);
          } else {
            allClientsConnected = false;
          }
        } else {
          allClientsConnected = false;
        }
        count += 1;
      }

      if (allClientsConnected) {
        Serial.printf("Clients connected, system time: %d\n", millis());
        while (allClientsConnected) {
          uint8_t connectionCount = 0;
          for (WiFiClient client : myClients) {
            if (client) {
              if (client.connected()) {
                // Serial.printf("Sending array on connection no. %d,
                // connections " "total: %d\n", connectionCount,
                // myClients.size());
                client.write(testArray, ARRAY_SIZE);
              } else {
                Serial.println("Client is not connected anymore");
                client.stop();
                allClientsConnected = false;
                break;
              }
            } else {
              Serial.println("Client object is null");
              allClientsConnected = false;
              break;
            }
            connectionCount += 1;
          }
        }
        for (WiFiClient client : myClients) {
          client.stop();
        }
        alreadySeenConnected.clear();
        myClients.clear();
        Serial.println("Client disconnected");
        testActive = false;
      }
    }
    for (WiFiServer *serv : servers) {
      serv->close();
      serv->end();
      delete (serv);
    }
  }
}

void singleTest() {
  WiFiServer wifiServer(BASE_PORT);
  wifiServer.begin();

  while (true) {
    WiFiClient client = wifiServer.available();

    if (client) {
      Serial.printf("Client connected, system time: %d\n", millis());
      uint32_t sentCount = 0;
      while (client.connected()) {
        client.write(testArray, ARRAY_SIZE);
        sentCount += 1;
        // delay(10);
      }

      client.stop();
      Serial.println("Client disconnected");
      Serial.printf("Sent count: %d", sentCount);
    }
  }
}

void setup() {

  Serial.begin(115200);

  delay(1000);

  WiFi.setHostname("ESP32_SERVER");

  WiFi.begin(ssid, password);

  while (WiFi.status() != WL_CONNECTED) {
    delay(1000);
    Serial.println("Connecting to WiFi..");
  }

  Serial.println("Connected to the WiFi network");
  Serial.println(WiFi.localIP());

  // singleTest();
  parallelTest();
}

void loop() {}
